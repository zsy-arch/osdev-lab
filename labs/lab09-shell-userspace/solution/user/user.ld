/* Lab9：用户程序链接脚本（两个架构共用一份）。
 *
 * 跟 Lab7/Lab8 的 user_prog.ld 的关系
 * ----------------------------------
 * 那两个 Lab 里的用户程序只有一个，构建方式是：链接成 ELF，再用 objcopy
 * 抠出纯二进制（-O binary），把裸字节嵌进内核镜像（user_blob.S），内核
 * 把这块字节整体拷到 0x400000 就能跑。链接脚本里只列了 .text 和 .rodata,
 * 因为手写汇编的用户程序没有 .data 也没有 .bss。
 *
 * 本 Lab 变了两件事，链接脚本必须跟着变：
 *
 *   1. 产物要保持 ELF 格式，不再 objcopy 成裸二进制。因为现在有 6 个用户
 *      程序，它们作为文件躺在文件系统镜像里，由内核的 ELF 加载器
 *      （exec.c）在运行时解析。ELF 的 program header 告诉加载器每一段
 *      放到哪个虚拟地址、有多大、是否可写可执行——这些信息裸二进制里全
 *      没有，Lab7/Lab8 是靠"内核和链接脚本都写死 0x400000"这个约定来
 *      弥补的。一旦程序有多个段、权限还不同，写死就不够用了。
 *
 *   2. 必须显式列出 .data 和 .bss。用 C 写的程序有全局变量：sh.c 里的
 *      行缓冲区在 .bss，字符串字面量在 .rodata，初始化过的全局表在
 *      .data。一个段忘了列，链接器会把它丢进输出文件末尾一个没人管的
 *      位置，或者（更糟）默默地放在某个 program header 覆盖不到的地方
 *      ——加载器不会报错，程序跑起来读到的全局变量是垃圾。
 *
 * 为什么一份脚本能同时给两个架构用
 * ------------------------------
 * 因为链接脚本描述的是*段的布局*，而段的名字和布局需求跟架构无关：代码
 * 在一起、只读数据在一起、可写数据在一起。架构差异体现在别处（指令编码、
 * 调用约定），链接器靠 -m 选项和输入 .o 的格式自己搞定。
 *
 * 唯一需要照顾架构差异的是段名的*集合*：riscv64 会产生 .sdata/.sbss
 * （small data，通过 gp 寄存器做短偏移寻址），x86_64 不会。把这两个名字
 * 写进脚本里对 x86_64 是无害的空匹配。反过来如果漏掉，riscv64 上的全局
 * 变量会静默错位——这个坑本课程前面几个 Lab 的内核 linker.ld 里踩过
 * （见 Lab5 关于 timer_ticks 的说明）。
 */

/* 入口符号。Lab7/Lab8 叫 _user_start，本 Lab 改叫 _start ——因为现在这是
 * 一个正常的独立程序，而 _start 是 ELF 世界里约定的程序入口名（真实
 * 系统上 libc 的 crt1.o 提供 _start，它做完初始化再 call main）。
 *
 * 这个符号名会被写进 ELF header 的 e_entry 字段，加载器读的是那个字段而
 * 不是符号名——所以叫什么其实无所谓，e_entry 是数值。改名纯粹是为了让
 * 源码看起来像真实世界的程序。 */
ENTRY(_start)

/* 用户程序的加载地址，跟 Lab7/Lab8 保持一致。
 *
 * 为什么是 0x400000（4 MiB）而不是 0：
 *   - 地址 0 附近要留出来给空指针解引用。不映射第一个页（以及往后一大段），
 *     *p = 0 时才会缺页而不是默默写坏什么东西。
 *   - 0x400000 也是传统 Linux/x86 可执行文件的默认加载地址，选它纯属
 *     致敬；重要的是"低地址留空"这个性质，具体数值无所谓。
 *
 * 用户地址空间的布局（跟内核的对照见 README 的对照表）：
 *
 *     0x00000000  ┌──────────────┐
 *                 │  未映射      │ ← 空指针陷阱区
 *     0x00400000  ├──────────────┤
 *                 │  .text       │ 只读 + 可执行
 *                 │  .rodata     │
 *                 ├──────────────┤ ← ALIGN(0x1000)，段边界
 *                 │  .data       │ 可读 + 可写，不可执行
 *                 │  .bss        │
 *                 └──────────────┘
 *                       ...
 *     USER_STACK_VADDR├──────────────┤
 *                 │  用户栈      │ 可读 + 可写（proc.c 单独映射）
 *                 └──────────────┘
 */
. = 0x400000;

SECTIONS
{
    /* 第一个段：只读 + 可执行。
     *
     * 注意 .text 和 .rodata 放在同一个页权限组里，意味着代码段可读。
     * 这是常态（字符串字面量在 .rodata，取地址读它需要读权限），而且
     * x86_64 的页表没有"可执行但不可读"这种组合。
     *
     * 真正要避免的是反过来的组合：可写*且*可执行。那是攻击者往数据里写
     * 一段机器码再跳进去的前提。所以下面用 ALIGN 把可写的东西推到另一个
     * 页去，让加载器能给两组页设不同权限。 */
    .text : {
        *(.text .text.*)
    }

    .rodata : {
        *(.rodata .rodata.*)
        /* riscv64 的 .srodata：small read-only data，跟 .sdata 同理。 */
        *(.srodata .srodata.*)
    }

    /* 段边界对齐。
     *
     * 这一行是整个脚本里最容易被忽略、又最必要的一行。页表的权限粒度是
     * 一个页（4 KiB）。如果 .rodata 的末尾和 .data 的开头落在同一个页里,
     * 加载器就没法给这个页同时设"只读"和"可写"——只能二选一：
     *
     *   选可写 → .rodata 变成可写的，常量能被改，而且如果这个页还带
     *            可执行权限（因为 .text 也可能挤在里面），就出现了
     *            W+X 页。
     *   选只读 → 程序往全局变量里写第一个字节就缺页，直接跑不起来。
     *
     * ALIGN(0x1000) 把 . 推进到下一个页边界，两组内容之间就有了干净的
     * 分界。代价是最多浪费 4 KiB - 1 字节；对一个能用页权限保护的程序
     * 来说，这个交换从来都值。
     *
     * 真实的 ld 默认就会做这件事（用 -z max-page-size 指定粒度），但只在
     * 它自己决定段布局的时候；我们手写 SECTIONS 就得自己写。
     *
     * 构建时还要配一个 -z max-page-size=4096：GNU ld 对 x86_64 默认按
     * 2 MiB 对齐段（为了让内核能用大页映射），会在 .text 和 .data 之间
     * 留出接近 2 MiB 的空洞。我们的加载器逐页搬运，那个空洞会变成上百个
     * 多余的页——文件也会膨胀到 2 MiB 以上，塞不进我们 512 块的文件系统。 */
    . = ALIGN(0x1000);

    .data : {
        *(.data .data.*)
        /* riscv64 的 .sdata：编译器把小的全局变量放这里，用 gp 寄存器加
         * 12 位偏移寻址，省一条指令。x86_64 不产生这个段，这行空匹配。
         *
         * 注意 .sdata 必须跟 .data 挨在一起并且不能被丢掉：gp 指向这一片
         * 的中间，所有短偏移寻址都相对它。 */
        *(.sdata .sdata.*)
    }

    /* .bss：未初始化（或初始化为 0）的全局变量。
     *
     * 它在文件里不占空间，只在 program header 里表现为"p_memsz 比
     * p_filesz 大"。加载器必须把这一块多出来的字节清零——不清的话，
     * 全局变量的初值是上一个用过这块物理内存的进程留下的垃圾。
     *
     * 这是 ELF 加载器最容易漏的一步，因为漏了通常还能跑：kalloc 拿到的
     * 页往往恰好是 0（刚开机时物理内存本来就是 0）。等到 fork/exec 跑过
     * 几轮、页被回收复用之后才开始出怪事。见 exec.c 里对应的注释。
     *
     * 注意 .bss 跟 .data 故意放在同一个页权限组里（中间没有 ALIGN）:
     * 两者权限完全相同（可读可写不可执行），没有理由分开，分开只会多浪费
     * 一个页。 */
    .bss : {
        *(.bss .bss.*)
        *(.sbss .sbss.*)
        /* COMMON：C 里 `int x;` 写在文件作用域、又没有初始化值时，老的
         * 编译器（以及 -fcommon）会把它放进一个叫 COMMON 的特殊段，等着
         * 链接器合并同名的多份定义。现代 GCC 默认 -fno-common 了（重复
         * 定义直接报错，这是好事），但保留这一行是廉价的保险。 */
        *(COMMON)
    }

    /* 丢掉不需要的元数据段。
     *
     * .comment    编译器版本字符串
     * .eh_frame   异常处理/栈回溯信息，C++ 异常和 backtrace 用，我们没有
     * .note.*     各种注记（包括上面 .S 文件里声明的 .note.GNU-stack）
     * .riscv.attributes  riscv64 特有的 ISA 属性记录
     *
     * 不丢会怎样：它们会变成额外的节，多半不在任何 PT_LOAD 段里，所以
     * 加载器根本不会看它们——纯粹是让文件变大。但"纯粹变大"在这里有实际
     * 后果：我们的文件系统只有 512 个块（512 KiB），6 个程序都要塞进去。
     *
     * 更重要的是丢掉它们让 readelf 的输出短到能一眼看完，调试加载器的
     * 时候这一点很值。 */
    /DISCARD/ : {
        *(.comment)
        *(.eh_frame)
        *(.eh_frame_hdr)
        *(.note .note.*)
        *(.riscv.attributes)
        /* 调试信息也丢掉。想用 GDB 调用户程序的话，应该保留一份没有
         * DISCARD 的副本给 GDB（gdb 读的是文件，不是内存），而磁盘镜像里
         * 放精简版。README 的调试一节讲怎么做。 */
        *(.debug_*)
    }
}
