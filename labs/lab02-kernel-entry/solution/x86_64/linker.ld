/* Lab2 x86_64 链接脚本：在 Lab1 的基础上补两件事——
 *
 * 1. 暴露 __bss_start/__bss_end 两个符号，boot.S 拿它们算出 BSS 的
 *    准确范围，手动清零。Lab1 的 BSS（页表用的 pml4/pdpt/pd）能"恰好
 *    工作"，是因为 GRUB 加载 ELF 时，对 .bss 这种 SHT_NOBITS 段本来就是
 *    "分配空间但不从文件里读数据"，多数 bootloader/加载器的实现顺手把这
 *    块内存清零了——但这是加载器的行为，不是 ELF 规范或 x86 硬件的保证。
 *    规范只保证".bss 在文件里不占空间"，不保证"加载后内容是 0"。
 *    Lab2 不再依赖这个"通常成立但没有书面保证"的行为，内核自己负责清零。
 *
 * 2. 用链接脚本定义栈的边界符号（__stack_top），而不是像 Lab1 那样在
 *    boot.S 里用 .align + .skip 在 .bss 段里"就地"开一块空间当栈。
 *    这是本 Lab 想教的"链接脚本控制内存布局"的核心：栈到底放在哪、多大，
 *    是链接阶段就该决定的布局问题，不应该散落在汇编代码里跟其它数据混在
 *    一起——这样以后想调整栈大小、或者给每个 CPU 核心一份独立栈
 *    （Lab10 会用到），只需要改链接脚本这一处。
 */
ENTRY(_start)

SECTIONS
{
    . = 0x100000;

    .multiboot : {
        *(.multiboot)
    }

    .text : {
        KEEP(*(.text.boot))
        *(.text)
        *(.text.*)
    }

    .rodata : {
        *(.rodata)
        *(.rodata.*)
    }

    .data : {
        *(.data)
        *(.data.*)
    }

    /* ALIGN(4096) 是有意加的，不只是"顺手"：如果不强制 .bss 页对齐，
     * 链接器会把它和前面的 .text/.rodata 合并进同一个 PT_LOAD 段，
     * 这个段的权限是所有被合并节权限的按位或——.text 要 R+E，.bss 要 W，
     * 合出来就是可写又可执行（RWE），`readelf -l` 能直接看到这一列。
     * 这份链接脚本能"恰好"避开这个问题，是因为 boot.S 里 pml4 这个
     * BSS 变量自己声明了 .align 4096（PAE 页表本身需要页对齐，跟这里
     * 想保证的事无关），如果哪天 boot.S 改了页表实现方式、不再需要那个
     * 对齐指令，.bss 就会退化成不对齐、重新合并出 RWE 段——不该让
     * "段权限是否安全"依赖一个跟它毫不相关的巧合，所以在链接脚本这里
     * 显式加上，riscv64 那份链接脚本遇到的就是这个问题的真实案例
     * （没有这个巧合掩护，直接触发了 RWE），见那边的详细注释。 */
    . = ALIGN(4096);
    __bss_start = .;
    .bss : {
        *(.bss)
        *(.bss.*)
        *(COMMON)
    }
    __bss_end = .;

    /* 栈单独放在 BSS 之后、由链接脚本直接摆放，不占用任何 C 变量的
     * 符号名字——boot.S 只需要引用 __stack_top 这一个符号。
     * 16KiB 对 Lab2 阶段（还没有中断栈帧、没有多层函数调用）绰绰有余；
     * 这个数字本身不是本课重点，重点是"这个数字现在写在链接脚本这一处，
     * 不是写在汇编代码里的 .skip 常量"。 */
    . = ALIGN(16);
    __stack_bottom = .;
    . += 16384;
    __stack_top = .;

    /DISCARD/ : {
        *(.comment)
        *(.eh_frame)
    }
}
